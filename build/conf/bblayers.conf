## build/conf/bblayers.conf
```bitbake
# POKY_BBLAYERS_CONF_VERSION is increased each time build/conf/bblayers.conf
# changes incompatibly
POKY_BBLAYERS_CONF_VERSION = "2"

BBPATH = "${TOPDIR}"
BBFILES ?= ""

BBLAYERS ?= " \
  /home/sonle2/Working/poky/meta \
  /home/sonle2/Working/poky/meta-poky \
  /home/sonle2/Working/poky/meta-yocto-bsp \
  "
```
